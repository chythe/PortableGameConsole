/**************************************************************************//**
* @file     I2CController.c
* @brief    Kontroler interfejsu I2C - source file
* @author   Mateusz Chudy
******************************************************************************/

#include <avr/io.h>
#include "I2CController.h"

/**************************************************************************//**
 * @brief Inicjalizuje komunikacje po I2C.
 *****************************************************************************/
void I2CInit(void)
{
	DDRC = 0x00;
	PORTC = (1 << PORTC0) | (1 << PORTC1); // umozliwia pull-up odpowiednio na SDA i SCL
	TWSR = 0x00; // prescaler 1
	TWBR = 12; // przy czestotliwosci SCL 400kHz
}

/**************************************************************************//**
 * @brief Wlacza przesyl / odbior danych po I2C.
 *****************************************************************************/
void I2CStart(void)
{
    TWCR = (1 << TWINT) | (1 << TWSTA) | (1 << TWEN);
    while (!(TWCR & (1 << TWINT)));
}

/**************************************************************************//**
 * @brief Wysyla bajt danych.
 * @param byte - wysylany bajt danych
 *****************************************************************************/
void I2CWriteByte(int8_t byte)
{
    TWDR = byte;
    TWCR = (1 << TWINT) | (1 << TWEN);
    while (!(TWCR & (1 << TWINT)));
}

// ----------------------------------------------------------------------------
// End of file ----------------------------------------------------------------
// ----------------------------------------------------------------------------


/**************************************************************************//**
 * @brief Odbiera bajt danych.
 * @return odebrany bajt danych
 *****************************************************************************/
int8_t I2CReadByte(void)
{
    TWCR = (1 << TWINT) | (1 << TWEA) | (1 << TWEN);
    while (!(TWCR & (1 << TWINT)));
    return TWDR;
}

/**************************************************************************//**
 * @brief Odbiera ostatni bajt danych.
 * @return odebrany ostatni bajt danych
 *****************************************************************************/
int8_t I2CReadLastByte(void)
{
	TWCR = (1 << TWINT) | (1 << TWEN);
	while (!(TWCR & (1 << TWINT)));
	return TWDR;
}

/**************************************************************************//**
 * @brief Wylacza przesyl / odbior danych po I2C.
 *****************************************************************************/
void I2CStop(void)
{
    TWCR = (1 << TWINT) | (1 << TWSTO) | (1 << TWEN);
}

// ----------------------------------------------------------------------------
// End of file ----------------------------------------------------------------
// ----------------------------------------------------------------------------
